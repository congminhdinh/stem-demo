// Scenario: none, kit: ref-uno-rover@0, board: uno-r3@0
// Generated by STEM Studio from the blocks: editing this code does not change the lab.
// Target: arduino:avr:uno, contract uno-arduino-avr 0.1.3. Libraries: arduino:avr@1.8.8 (LGPL-2.1)

#define MOTOR_LEFT_EN 5
#define MOTOR_LEFT_IN1 7
#define MOTOR_LEFT_IN2 8
#define ULTRASONIC_TRIG 12
#define ULTRASONIC_ECHO 11
#define LINE_LEFT_PIN A0
#define LINE_CENTER_PIN A1
#define LINE_RIGHT_PIN A2
#define BUZZER_PIN 10

long x = 0L;
long y = 0L;

long add32(long a, long b) { return (long)((unsigned long)a + (unsigned long)b); }
long sub32(long a, long b) { return (long)((unsigned long)a - (unsigned long)b); }
long mul32(long a, long b) { return (long)((unsigned long)a * (unsigned long)b); }
long neg32(long a) { return (long)(0UL - (unsigned long)a); }
long div32(long a, long b) { return b == -1L ? neg32(a) : (b == 0L ? 0L : a / b); }
long mod32(long a, long b) { return (b == -1L || b == 0L) ? 0L : a % b; }

void motorSet(uint8_t en, uint8_t in1, uint8_t in2, long speed) {
  if (speed > 100L) speed = 100L;
  if (speed < -100L) speed = -100L;
  long magnitude = speed < 0L ? -speed : speed;
  digitalWrite(in1, speed > 0L ? HIGH : LOW);
  digitalWrite(in2, speed < 0L ? HIGH : LOW);
  analogWrite(en, (int)((magnitude * 255L + 50L) / 100L));
}

long ultrasonicCm(uint8_t trig, uint8_t echo) {
  digitalWrite(trig, LOW);
  delayMicroseconds(2);
  digitalWrite(trig, HIGH);
  delayMicroseconds(10);
  digitalWrite(trig, LOW);
  long us = (long)pulseIn(echo, HIGH, 30000UL);
  if (us == 0L) return 400L;
  long cm = us / 58L;
  if (cm < 2L) return 2L;
  if (cm > 400L) return 400L;
  return cm;
}

void buzzerTone(uint8_t pin, long hz, long ms) {
  if (hz < 31L) hz = 31L;
  if (hz > 4000L) hz = 4000L;
  if (ms < 1L) ms = 1L;
  if (ms > 60000L) ms = 60000L;
  tone(pin, (unsigned int)hz, (unsigned long)ms);
}

void setup() {
  Serial.begin(9600);
  pinMode(MOTOR_LEFT_EN, OUTPUT);
  pinMode(MOTOR_LEFT_IN1, OUTPUT);
  pinMode(MOTOR_LEFT_IN2, OUTPUT);
  pinMode(ULTRASONIC_TRIG, OUTPUT);
  pinMode(ULTRASONIC_ECHO, INPUT);
  long _s1;
  long _s2;
  long _s3;
  long _s4;
  long _s5;
  long _s6;
  long _s7;
  long _s8;
  long _s9;
  long _s10;
  long _s11;
  long _s12;
  Serial.println((_s1 = (long)analogRead(LINE_LEFT_PIN), _s2 = (long)analogRead(LINE_RIGHT_PIN), sub32(_s1, _s2)));
  x = (_s3 = ultrasonicCm(ULTRASONIC_TRIG, ULTRASONIC_ECHO), _s4 = ultrasonicCm(ULTRASONIC_TRIG, ULTRASONIC_ECHO), add32(_s3, _s4));
  Serial.println(x);
  Serial.println((_s5 = (long)analogRead(LINE_LEFT_PIN), _s6 = (long)analogRead(LINE_RIGHT_PIN), (_s5 > add32(_s6, 5L))));
  (_s7 = (long)analogRead(LINE_CENTER_PIN), _s8 = ultrasonicCm(ULTRASONIC_TRIG, ULTRASONIC_ECHO), buzzerTone(BUZZER_PIN, _s7, _s8));
  motorSet(MOTOR_LEFT_EN, MOTOR_LEFT_IN1, MOTOR_LEFT_IN2, (_s9 = (long)analogRead(LINE_LEFT_PIN), _s10 = (long)analogRead(LINE_RIGHT_PIN), sub32(_s9, _s10)));
  Serial.print(F("d = "));
  Serial.println((_s11 = ultrasonicCm(ULTRASONIC_TRIG, ULTRASONIC_ECHO), _s12 = ultrasonicCm(ULTRASONIC_TRIG, ULTRASONIC_ECHO), sub32(_s11, _s12)));
}

void loop() {
}

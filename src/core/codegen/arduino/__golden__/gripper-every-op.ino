// Scenario: none, kit: ref-uno-gripper@0, board: uno-r3@0
// Generated by STEM Studio from the blocks: editing this code does not change the lab.
// Target: arduino:avr:uno, contract uno-arduino-avr 0.1.7. Libraries: arduino:avr@1.8.8 (LGPL-2.1), Servo@1.3.0 (LGPL-2.1), Wire@1.0 (LGPL-2.1)

#include <Servo.h>
#include <Wire.h>

#define MOTOR_LEFT_EN 5
#define MOTOR_LEFT_IN1 7
#define MOTOR_LEFT_IN2 8
#define MOTOR_RIGHT_EN 6
#define MOTOR_RIGHT_IN1 4
#define MOTOR_RIGHT_IN2 2
#define GRIPPER_CLAW 9
#define GRIPPER_LIFT 10
#define IR_CLAW_PIN A3
#define COLOR1_SDA A4
#define COLOR1_SCL A5

Servo gripperClaw;
Servo gripperLift;
uint16_t colorC = 0;
uint16_t colorR = 0;
uint16_t colorG = 0;
uint16_t colorB = 0;
long x = 0L;
long y = 0L;

long add32(long a, long b) { return (long)((unsigned long)a + (unsigned long)b); }
long sub32(long a, long b) { return (long)((unsigned long)a - (unsigned long)b); }
long mul32(long a, long b) { return (long)((unsigned long)a * (unsigned long)b); }
long neg32(long a) { return (long)(0UL - (unsigned long)a); }
long div32(long a, long b) { return b == -1L ? neg32(a) : (b == 0L ? 0L : a / b); }
long mod32(long a, long b) { return (b == -1L || b == 0L) ? 0L : a % b; }

void motorSet(uint8_t en, uint8_t in1, uint8_t in2, long speed) {
  if (speed > 100L) speed = 100L;
  if (speed < -100L) speed = -100L;
  long magnitude = speed < 0L ? -speed : speed;
  digitalWrite(in1, speed > 0L ? HIGH : LOW);
  digitalWrite(in2, speed < 0L ? HIGH : LOW);
  analogWrite(en, (int)((magnitude * 255L + 50L) / 100L));
}

void gripperSet(Servo &servo, long angle) {
  if (angle < 0L) angle = 0L;
  if (angle > 90L) angle = 90L;
  servo.write((int)angle);
}

#define COLOR_ADDR 0x29
#define COLOR_RULE_COUNT 7
const uint16_t COLOR_RULES[COLOR_RULE_COUNT][9] PROGMEM = {
  {6, 0, 299, 0, 1000, 0, 1000, 0, 1000},
  {0, 0, 65535, 500, 1000, 0, 299, 0, 1000},
  {1, 0, 65535, 0, 329, 420, 1000, 0, 1000},
  {2, 0, 65535, 0, 299, 0, 1000, 420, 1000},
  {4, 12000, 65535, 0, 419, 0, 1000, 230, 1000},
  {3, 0, 65535, 380, 1000, 330, 1000, 0, 229},
  {5, 0, 3999, 0, 1000, 0, 1000, 0, 1000},
};
void colorWrite(uint8_t reg, uint8_t value) {
  Wire.beginTransmission(COLOR_ADDR);
  Wire.write((uint8_t)(0x80 | reg));
  Wire.write(value);
  Wire.endTransmission();
}
void colorBegin() {
  Wire.begin();
  Wire.setWireTimeout(3000, true);
  colorWrite(0x01, 0xEB);
  colorWrite(0x0F, 0x01);
  colorWrite(0x00, 0x01);
  delay(3);
  colorWrite(0x00, 0x03);
  delay(54);
}
void colorFetch() {
  Wire.beginTransmission(COLOR_ADDR);
  Wire.write((uint8_t)0xB4);
  if (Wire.endTransmission() != 0 || Wire.requestFrom((uint8_t)COLOR_ADDR, (uint8_t)8) != 8) {
    colorC = 0;
    colorR = 0;
    colorG = 0;
    colorB = 0;
    return;
  }
  uint8_t bytes[8];
  for (uint8_t i = 0; i < 8; i++) {
    bytes[i] = (uint8_t)Wire.read();
  }
  colorC = (uint16_t)bytes[0] | ((uint16_t)bytes[1] << 8);
  colorR = (uint16_t)bytes[2] | ((uint16_t)bytes[3] << 8);
  colorG = (uint16_t)bytes[4] | ((uint16_t)bytes[5] << 8);
  colorB = (uint16_t)bytes[6] | ((uint16_t)bytes[7] << 8);
}
uint8_t colorClassify() {
  unsigned long sum = (unsigned long)colorR + colorG + colorB;
  uint16_t r = sum == 0UL ? 0 : (uint16_t)((colorR * 1000UL) / sum);
  uint16_t g = sum == 0UL ? 0 : (uint16_t)((colorG * 1000UL) / sum);
  uint16_t b = sum == 0UL ? 0 : (uint16_t)((colorB * 1000UL) / sum);
  for (uint8_t i = 0; i < COLOR_RULE_COUNT; i++) {
    const uint16_t *rule = COLOR_RULES[i];
    if (colorC >= pgm_read_word(&rule[1]) && colorC <= pgm_read_word(&rule[2]) &&
        r >= pgm_read_word(&rule[3]) && r <= pgm_read_word(&rule[4]) &&
        g >= pgm_read_word(&rule[5]) && g <= pgm_read_word(&rule[6]) &&
        b >= pgm_read_word(&rule[7]) && b <= pgm_read_word(&rule[8])) {
      return (uint8_t)pgm_read_word(&rule[0]);
    }
  }
  return 6;
}
bool colorIs(uint8_t n) {
  colorFetch();
  return colorClassify() == n;
}
long colorRaw(uint8_t k) {
  colorFetch();
  if (k == 0) return (long)colorR;
  if (k == 1) return (long)colorG;
  if (k == 2) return (long)colorB;
  return (long)colorC;
}

void setup() {
  Serial.begin(9600);
  pinMode(MOTOR_LEFT_EN, OUTPUT);
  pinMode(MOTOR_LEFT_IN1, OUTPUT);
  pinMode(MOTOR_LEFT_IN2, OUTPUT);
  pinMode(MOTOR_RIGHT_EN, OUTPUT);
  pinMode(MOTOR_RIGHT_IN1, OUTPUT);
  pinMode(MOTOR_RIGHT_IN2, OUTPUT);
  gripperClaw.attach(GRIPPER_CLAW);
  gripperClaw.write(0);
  gripperLift.attach(GRIPPER_LIFT);
  gripperLift.write(90);
  pinMode(IR_CLAW_PIN, INPUT);
  colorBegin();
  gripperSet(gripperLift, 0L);
  gripperSet(gripperClaw, 0L);
  x = 40L;
}

void loop() {
  while (!((digitalRead(IR_CLAW_PIN) == LOW))) {
    {
      const long _s = (50L);
      motorSet(MOTOR_LEFT_EN, MOTOR_LEFT_IN1, MOTOR_LEFT_IN2, _s);
      motorSet(MOTOR_RIGHT_EN, MOTOR_RIGHT_IN1, MOTOR_RIGHT_IN2, _s);
    }
  }
  motorSet(MOTOR_LEFT_EN, MOTOR_LEFT_IN1, MOTOR_LEFT_IN2, 0L);
  motorSet(MOTOR_RIGHT_EN, MOTOR_RIGHT_IN1, MOTOR_RIGHT_IN2, 0L);
  gripperSet(gripperClaw, 80L);
  gripperSet(gripperLift, 90L);
  if (colorIs(0L)) {
    gripperSet(gripperLift, 45L);
  } else if (colorIs(6L)) {
    gripperSet(gripperClaw, add32(x, 5L));
  }
  Serial.println(colorRaw(3L));
  gripperSet(gripperLift, 0L);
  gripperSet(gripperClaw, 0L);
}

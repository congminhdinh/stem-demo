// Scenario: none, kit: ref-uno-rover@0, board: uno-r3@0
// Generated by STEM Studio from the blocks: editing this code does not change the lab.
// Target: arduino:avr:uno, contract uno-arduino-avr 0.1.7. Libraries: arduino:avr@1.8.8 (LGPL-2.1)

#define ULTRASONIC_TRIG 12
#define ULTRASONIC_ECHO 11
#define LINE_LEFT_PIN A0
#define LINE_CENTER_PIN A1
#define LINE_RIGHT_PIN A2
#define BUTTON1_PIN 3

long x = 0L;
long y = 0L;

long add32(long a, long b) { return (long)((unsigned long)a + (unsigned long)b); }
long sub32(long a, long b) { return (long)((unsigned long)a - (unsigned long)b); }
long mul32(long a, long b) { return (long)((unsigned long)a * (unsigned long)b); }
long neg32(long a) { return (long)(0UL - (unsigned long)a); }
long div32(long a, long b) { return b == -1L ? neg32(a) : (b == 0L ? 0L : a / b); }
long mod32(long a, long b) { return (b == -1L || b == 0L) ? 0L : a % b; }

long ultrasonicCm(uint8_t trig, uint8_t echo) {
  digitalWrite(trig, LOW);
  delayMicroseconds(2);
  digitalWrite(trig, HIGH);
  delayMicroseconds(10);
  digitalWrite(trig, LOW);
  long us = (long)pulseIn(echo, HIGH, 30000UL);
  if (us == 0L) return 400L;
  long cm = us / 58L;
  if (cm < 2L) return 2L;
  if (cm > 400L) return 400L;
  return cm;
}

void setup() {
  Serial.begin(9600);
  pinMode(ULTRASONIC_TRIG, OUTPUT);
  pinMode(ULTRASONIC_ECHO, INPUT);
  pinMode(LINE_LEFT_PIN, INPUT);
  pinMode(LINE_CENTER_PIN, INPUT);
  pinMode(LINE_RIGHT_PIN, INPUT);
  pinMode(BUTTON1_PIN, INPUT_PULLUP);
  bool _s1;
  bool _s2;
  if (((digitalRead(LINE_LEFT_PIN) == HIGH) && (digitalRead(LINE_RIGHT_PIN) == HIGH))) {
    Serial.println(F("both"));
  }
  if (((digitalRead(BUTTON1_PIN) == LOW) || (ultrasonicCm(ULTRASONIC_TRIG, ULTRASONIC_ECHO) < 10L))) {
    Serial.println(F("stop"));
  }
  Serial.println(ultrasonicCm(ULTRASONIC_TRIG, ULTRASONIC_ECHO));
  Serial.println((_s1 = ((digitalRead(LINE_LEFT_PIN) == HIGH) && (digitalRead(LINE_CENTER_PIN) == HIGH)), _s2 = (digitalRead(LINE_RIGHT_PIN) == HIGH), (_s1 == _s2)));
  x = 0L;
  while ((!((digitalRead(BUTTON1_PIN) == LOW)) && (x < 3L))) {
    x = add32(x, 1L);
  }
  Serial.println(x);
}

void loop() {
}

// Scenario: none, kit: ref-uno-rover@0, board: uno-r3@0
// Generated by STEM Studio from the blocks: editing this code does not change the lab.
// Target: arduino:avr:uno, contract uno-arduino-avr 0.1.2. Libraries: arduino:avr@1.8.8 (LGPL-2.1)

long i = 0L;
long n = 0L;

long add32(long a, long b) { return (long)((unsigned long)a + (unsigned long)b); }
long sub32(long a, long b) { return (long)((unsigned long)a - (unsigned long)b); }
long mul32(long a, long b) { return (long)((unsigned long)a * (unsigned long)b); }
long neg32(long a) { return (long)(0UL - (unsigned long)a); }
long div32(long a, long b) { return b == -1L ? neg32(a) : (b == 0L ? 0L : a / b); }
long mod32(long a, long b) { return (b == -1L || b == 0L) ? 0L : a % b; }

void setup() {
  Serial.begin(9600);
  n = 3L;
  {
    const long _from = (1L);
    const long _to = (n);
    for (long _c = _from; _c <= _to; _c += 1L) {
      i = _c;
      n = add32(n, 1L);
      Serial.println(i);
    }
  }
  Serial.println(i);
  Serial.println(n);
  i = 99L;
  {
    const long _from = (n);
    const long _to = (2L);
    for (long _c = _from; _c <= _to; _c += 1L) {
      i = _c;
      Serial.println(i);
    }
  }
  Serial.println(i);
  {
    const long _from = (-2L);
    const long _to = (-1L);
    for (long _c = _from; _c <= _to; _c += 1L) {
      i = _c;
    }
  }
  Serial.println(i);
}

void loop() {
}

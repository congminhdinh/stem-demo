// Scenario: none, kit: ref-uno-rover@0, board: uno-r3@0
// Generated by STEM Studio from the blocks: editing this code does not change the lab.
// Target: arduino:avr:uno, contract uno-arduino-avr 0.1.6. Libraries: arduino:avr@1.8.8 (LGPL-2.1)

#define LINE_LEFT_PIN A0
#define LINE_RIGHT_PIN A2

long x = 0L;
long y = 0L;

long add32(long a, long b) { return (long)((unsigned long)a + (unsigned long)b); }
long sub32(long a, long b) { return (long)((unsigned long)a - (unsigned long)b); }
long mul32(long a, long b) { return (long)((unsigned long)a * (unsigned long)b); }
long neg32(long a) { return (long)(0UL - (unsigned long)a); }
long div32(long a, long b) { return b == -1L ? neg32(a) : (b == 0L ? 0L : a / b); }
long mod32(long a, long b) { return (b == -1L || b == 0L) ? 0L : a % b; }

void setup() {
  Serial.begin(9600);
  long _s1;
  long _s2;
  long _s3;
  long _s4;
  long _s5;
  long _s6;
  x = 0L;
  while ((_s1 = (long)analogRead(LINE_LEFT_PIN), _s2 = (long)analogRead(LINE_RIGHT_PIN), (_s1 < _s2))) {
    x = add32(x, 1L);
  }
  Serial.println(x);
  if ((_s3 = (long)analogRead(LINE_LEFT_PIN), _s4 = (long)analogRead(LINE_RIGHT_PIN), (_s3 > _s4))) {
    Serial.println(F("left"));
  } else if ((_s5 = (long)analogRead(LINE_LEFT_PIN), _s6 = (long)analogRead(LINE_RIGHT_PIN), (_s5 < _s6))) {
    Serial.println(F("right"));
  } else {
    Serial.println(F("same"));
  }
}

void loop() {
}

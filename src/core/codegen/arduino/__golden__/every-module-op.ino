// Scenario: none, kit: ref-uno-rover@0, board: uno-r3@0
// Generated by STEM Studio from the blocks: editing this code does not change the lab.
// Target: arduino:avr:uno, contract uno-arduino-avr 0.1.6. Libraries: arduino:avr@1.8.8 (LGPL-2.1), Servo@1.3.0 (LGPL-2.1)

#include <Servo.h>

#define MOTOR_LEFT_EN 5
#define MOTOR_LEFT_IN1 7
#define MOTOR_LEFT_IN2 8
#define MOTOR_RIGHT_EN 6
#define MOTOR_RIGHT_IN1 4
#define MOTOR_RIGHT_IN2 2
#define ULTRASONIC_TRIG 12
#define ULTRASONIC_ECHO 11
#define LINE_LEFT_PIN A0
#define LINE_CENTER_PIN A1
#define LINE_RIGHT_PIN A2
#define LED1_PIN 13
#define BUTTON1_PIN 3
#define SERVO1_PIN 9
#define BUZZER_PIN 10

Servo servo1;
long x = 0L;
long y = 0L;

long add32(long a, long b) { return (long)((unsigned long)a + (unsigned long)b); }
long sub32(long a, long b) { return (long)((unsigned long)a - (unsigned long)b); }
long mul32(long a, long b) { return (long)((unsigned long)a * (unsigned long)b); }
long neg32(long a) { return (long)(0UL - (unsigned long)a); }
long div32(long a, long b) { return b == -1L ? neg32(a) : (b == 0L ? 0L : a / b); }
long mod32(long a, long b) { return (b == -1L || b == 0L) ? 0L : a % b; }

void motorSet(uint8_t en, uint8_t in1, uint8_t in2, long speed) {
  if (speed > 100L) speed = 100L;
  if (speed < -100L) speed = -100L;
  long magnitude = speed < 0L ? -speed : speed;
  digitalWrite(in1, speed > 0L ? HIGH : LOW);
  digitalWrite(in2, speed < 0L ? HIGH : LOW);
  analogWrite(en, (int)((magnitude * 255L + 50L) / 100L));
}

long ultrasonicCm(uint8_t trig, uint8_t echo) {
  digitalWrite(trig, LOW);
  delayMicroseconds(2);
  digitalWrite(trig, HIGH);
  delayMicroseconds(10);
  digitalWrite(trig, LOW);
  long us = (long)pulseIn(echo, HIGH, 30000UL);
  if (us == 0L) return 400L;
  long cm = us / 58L;
  if (cm < 2L) return 2L;
  if (cm > 400L) return 400L;
  return cm;
}

void servoSet(Servo &servo, long angle) {
  if (angle < 0L) angle = 0L;
  if (angle > 180L) angle = 180L;
  servo.write((int)angle);
}

void buzzerTone(uint8_t pin, long hz, long ms) {
  if (hz < 31L) hz = 31L;
  if (hz > 4000L) hz = 4000L;
  if (ms < 1L) ms = 1L;
  if (ms > 60000L) ms = 60000L;
  tone(pin, (unsigned int)hz, (unsigned long)ms);
}

void setup() {
  Serial.begin(9600);
  pinMode(MOTOR_LEFT_EN, OUTPUT);
  pinMode(MOTOR_LEFT_IN1, OUTPUT);
  pinMode(MOTOR_LEFT_IN2, OUTPUT);
  pinMode(MOTOR_RIGHT_EN, OUTPUT);
  pinMode(MOTOR_RIGHT_IN1, OUTPUT);
  pinMode(MOTOR_RIGHT_IN2, OUTPUT);
  pinMode(ULTRASONIC_TRIG, OUTPUT);
  pinMode(ULTRASONIC_ECHO, INPUT);
  pinMode(LINE_LEFT_PIN, INPUT);
  pinMode(LINE_CENTER_PIN, INPUT);
  pinMode(LINE_RIGHT_PIN, INPUT);
  pinMode(LED1_PIN, OUTPUT);
  pinMode(BUTTON1_PIN, INPUT_PULLUP);
  servo1.attach(SERVO1_PIN);
  servo1.write(90);
  {
    const long _s = (60L);
    motorSet(MOTOR_LEFT_EN, MOTOR_LEFT_IN1, MOTOR_LEFT_IN2, _s);
    motorSet(MOTOR_RIGHT_EN, MOTOR_RIGHT_IN1, MOTOR_RIGHT_IN2, _s);
  }
  delay(100L);
  {
    const long _s = (60L);
    motorSet(MOTOR_LEFT_EN, MOTOR_LEFT_IN1, MOTOR_LEFT_IN2, neg32(_s));
    motorSet(MOTOR_RIGHT_EN, MOTOR_RIGHT_IN1, MOTOR_RIGHT_IN2, neg32(_s));
  }
  {
    const long _s = (40L);
    motorSet(MOTOR_LEFT_EN, MOTOR_LEFT_IN1, MOTOR_LEFT_IN2, neg32(_s));
    motorSet(MOTOR_RIGHT_EN, MOTOR_RIGHT_IN1, MOTOR_RIGHT_IN2, _s);
  }
  {
    const long _s = (x);
    motorSet(MOTOR_LEFT_EN, MOTOR_LEFT_IN1, MOTOR_LEFT_IN2, _s);
    motorSet(MOTOR_RIGHT_EN, MOTOR_RIGHT_IN1, MOTOR_RIGHT_IN2, neg32(_s));
  }
  motorSet(MOTOR_LEFT_EN, MOTOR_LEFT_IN1, MOTOR_LEFT_IN2, 0L);
  motorSet(MOTOR_RIGHT_EN, MOTOR_RIGHT_IN1, MOTOR_RIGHT_IN2, 0L);
  motorSet(MOTOR_LEFT_EN, MOTOR_LEFT_IN1, MOTOR_LEFT_IN2, 50L);
  motorSet(MOTOR_RIGHT_EN, MOTOR_RIGHT_IN1, MOTOR_RIGHT_IN2, -100L);
  servoSet(servo1, 45L);
  digitalWrite(LED1_PIN, (true) ? HIGH : LOW);
  digitalWrite(LED1_PIN, (false) ? HIGH : LOW);
  buzzerTone(BUZZER_PIN, 440L, 100L);
  noTone(BUZZER_PIN);
  x = ultrasonicCm(ULTRASONIC_TRIG, ULTRASONIC_ECHO);
  Serial.println(x);
  Serial.println((digitalRead(LINE_LEFT_PIN) == HIGH));
  Serial.println((digitalRead(LINE_CENTER_PIN) == HIGH));
  Serial.println((digitalRead(LINE_RIGHT_PIN) == HIGH));
  Serial.println((long)analogRead(LINE_LEFT_PIN));
  Serial.println((long)analogRead(LINE_CENTER_PIN));
  Serial.println((long)analogRead(LINE_RIGHT_PIN));
  Serial.println((digitalRead(BUTTON1_PIN) == LOW));
}

void loop() {
  if ((ultrasonicCm(ULTRASONIC_TRIG, ULTRASONIC_ECHO) < 20L)) {
    motorSet(MOTOR_LEFT_EN, MOTOR_LEFT_IN1, MOTOR_LEFT_IN2, 0L);
    motorSet(MOTOR_RIGHT_EN, MOTOR_RIGHT_IN1, MOTOR_RIGHT_IN2, 0L);
  } else {
    {
      const long _s = (50L);
      motorSet(MOTOR_LEFT_EN, MOTOR_LEFT_IN1, MOTOR_LEFT_IN2, _s);
      motorSet(MOTOR_RIGHT_EN, MOTOR_RIGHT_IN1, MOTOR_RIGHT_IN2, _s);
    }
  }
}

// Scenario: none, kit: ref-uno-rover@0, board: uno-r3@0
// Generated by STEM Studio from the blocks: editing this code does not change the lab.
// Target: arduino:avr:uno, contract uno-arduino-avr 0.1.6. Libraries: arduino:avr@1.8.8 (LGPL-2.1)

long x = 0L;
long y = 0L;
long i = 0L;

long add32(long a, long b) { return (long)((unsigned long)a + (unsigned long)b); }
long sub32(long a, long b) { return (long)((unsigned long)a - (unsigned long)b); }
long mul32(long a, long b) { return (long)((unsigned long)a * (unsigned long)b); }
long neg32(long a) { return (long)(0UL - (unsigned long)a); }
long div32(long a, long b) { return b == -1L ? neg32(a) : (b == 0L ? 0L : a / b); }
long mod32(long a, long b) { return (b == -1L || b == 0L) ? 0L : a % b; }

void setup() {
  Serial.begin(9600);
  x = 0L;
  while ((x < 3L)) {
    x = add32(x, 1L);
    if ((x == 1L)) {
      Serial.println(F("one"));
    } else if ((x == 2L)) {
      Serial.println(F("two"));
    } else {
      Serial.println(F("other"));
    }
  }
  {
    const long _from = (1L);
    const long _to = (2L);
    for (long _c = _from; _c <= _to; _c += 1L) {
      i = _c;
      {
        const long _n = (2L);
        for (long _r = 0L; _r < _n; _r += 1L) {
          {
            const long _from = (1L);
            const long _to = (2L);
            for (long _c = _from; _c <= _to; _c += 1L) {
              y = _c;
              Serial.println(add32(mul32(i, 10L), y));
            }
          }
        }
      }
    }
  }
  if ((!((x > 5L)) && ((x == 3L) || false))) {
    Serial.println(F("logic"));
  } else {
    Serial.println(F("no"));
  }
  {
    const long _n = (-3L);
    for (long _r = 0L; _r < _n; _r += 1L) {
      Serial.println(F("never"));
    }
  }
}

void loop() {
}

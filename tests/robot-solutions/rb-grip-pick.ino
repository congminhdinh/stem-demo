// Scenario: rb-grip-pick@1, kit: ref-uno-gripper@0, board: uno-r3@0
// Generated by STEM Studio from the blocks: editing this code does not change the lab.
// Target: arduino:avr:uno, contract uno-arduino-avr 0.1.7. Libraries: arduino:avr@1.8.8 (LGPL-2.1), Servo@1.3.0 (LGPL-2.1)

#include <Servo.h>

#define MOTOR_LEFT_EN 5
#define MOTOR_LEFT_IN1 7
#define MOTOR_LEFT_IN2 8
#define MOTOR_RIGHT_EN 6
#define MOTOR_RIGHT_IN1 4
#define MOTOR_RIGHT_IN2 2
#define ULTRASONIC_TRIG 12
#define ULTRASONIC_ECHO 11
#define GRIPPER_CLAW 9
#define GRIPPER_LIFT 10
#define IR_CLAW_PIN A3

Servo gripperClaw;
Servo gripperLift;

long add32(long a, long b) { return (long)((unsigned long)a + (unsigned long)b); }
long sub32(long a, long b) { return (long)((unsigned long)a - (unsigned long)b); }
long mul32(long a, long b) { return (long)((unsigned long)a * (unsigned long)b); }
long neg32(long a) { return (long)(0UL - (unsigned long)a); }
long div32(long a, long b) { return b == -1L ? neg32(a) : (b == 0L ? 0L : a / b); }
long mod32(long a, long b) { return (b == -1L || b == 0L) ? 0L : a % b; }

void motorSet(uint8_t en, uint8_t in1, uint8_t in2, long speed) {
  if (speed > 100L) speed = 100L;
  if (speed < -100L) speed = -100L;
  long magnitude = speed < 0L ? -speed : speed;
  digitalWrite(in1, speed > 0L ? HIGH : LOW);
  digitalWrite(in2, speed < 0L ? HIGH : LOW);
  analogWrite(en, (int)((magnitude * 255L + 50L) / 100L));
}

long ultrasonicCm(uint8_t trig, uint8_t echo) {
  digitalWrite(trig, LOW);
  delayMicroseconds(2);
  digitalWrite(trig, HIGH);
  delayMicroseconds(10);
  digitalWrite(trig, LOW);
  long us = (long)pulseIn(echo, HIGH, 30000UL);
  if (us == 0L) return 400L;
  long cm = us / 58L;
  if (cm < 2L) return 2L;
  if (cm > 400L) return 400L;
  return cm;
}

void gripperSet(Servo &servo, long angle) {
  if (angle < 0L) angle = 0L;
  if (angle > 90L) angle = 90L;
  servo.write((int)angle);
}

void setup() {
  pinMode(MOTOR_LEFT_EN, OUTPUT);
  pinMode(MOTOR_LEFT_IN1, OUTPUT);
  pinMode(MOTOR_LEFT_IN2, OUTPUT);
  pinMode(MOTOR_RIGHT_EN, OUTPUT);
  pinMode(MOTOR_RIGHT_IN1, OUTPUT);
  pinMode(MOTOR_RIGHT_IN2, OUTPUT);
  pinMode(ULTRASONIC_TRIG, OUTPUT);
  pinMode(ULTRASONIC_ECHO, INPUT);
  gripperClaw.attach(GRIPPER_CLAW);
  gripperClaw.write(0);
  gripperLift.attach(GRIPPER_LIFT);
  gripperLift.write(90);
  pinMode(IR_CLAW_PIN, INPUT);
  gripperSet(gripperLift, 0L);
  gripperSet(gripperClaw, 0L);
  delay(300L);
  {
    const long _s = (70L);
    motorSet(MOTOR_LEFT_EN, MOTOR_LEFT_IN1, MOTOR_LEFT_IN2, _s);
    motorSet(MOTOR_RIGHT_EN, MOTOR_RIGHT_IN1, MOTOR_RIGHT_IN2, _s);
  }
  while ((ultrasonicCm(ULTRASONIC_TRIG, ULTRASONIC_ECHO) > 15L)) {
  }
  {
    const long _s = (50L);
    motorSet(MOTOR_LEFT_EN, MOTOR_LEFT_IN1, MOTOR_LEFT_IN2, _s);
    motorSet(MOTOR_RIGHT_EN, MOTOR_RIGHT_IN1, MOTOR_RIGHT_IN2, _s);
  }
  while (!((digitalRead(IR_CLAW_PIN) == LOW))) {
  }
  motorSet(MOTOR_LEFT_EN, MOTOR_LEFT_IN1, MOTOR_LEFT_IN2, 0L);
  motorSet(MOTOR_RIGHT_EN, MOTOR_RIGHT_IN1, MOTOR_RIGHT_IN2, 0L);
  gripperSet(gripperClaw, 80L);
  delay(300L);
  gripperSet(gripperLift, 90L);
  delay(300L);
  {
    const long _s = (60L);
    motorSet(MOTOR_LEFT_EN, MOTOR_LEFT_IN1, MOTOR_LEFT_IN2, _s);
    motorSet(MOTOR_RIGHT_EN, MOTOR_RIGHT_IN1, MOTOR_RIGHT_IN2, _s);
  }
  while ((ultrasonicCm(ULTRASONIC_TRIG, ULTRASONIC_ECHO) > 45L)) {
  }
  motorSet(MOTOR_LEFT_EN, MOTOR_LEFT_IN1, MOTOR_LEFT_IN2, 0L);
  motorSet(MOTOR_RIGHT_EN, MOTOR_RIGHT_IN1, MOTOR_RIGHT_IN2, 0L);
  gripperSet(gripperLift, 0L);
  delay(300L);
  gripperSet(gripperClaw, 0L);
  delay(300L);
  {
    const long _s = (50L);
    motorSet(MOTOR_LEFT_EN, MOTOR_LEFT_IN1, MOTOR_LEFT_IN2, neg32(_s));
    motorSet(MOTOR_RIGHT_EN, MOTOR_RIGHT_IN1, MOTOR_RIGHT_IN2, neg32(_s));
  }
  delay(1000L);
  motorSet(MOTOR_LEFT_EN, MOTOR_LEFT_IN1, MOTOR_LEFT_IN2, 0L);
  motorSet(MOTOR_RIGHT_EN, MOTOR_RIGHT_IN1, MOTOR_RIGHT_IN2, 0L);
}

void loop() {
}
